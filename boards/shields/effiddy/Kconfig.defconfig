## boards/shields/effiddy/Kconfig.defconfig
```kconfig
if SHIELD_EFFIDDY_LEFT

config ZMK_KEYBOARD_NAME
    default "effiddy"

config ZMK_SPLIT_ROLE_CENTRAL
    default y

endif

if SHIELD_EFFIDDY_LEFT || SHIELD_EFFIDDY_RIGHT

config ZMK_SPLIT
    default y

endif
```

## boards/shields/effiddy/Kconfig.shield
```kconfig
config SHIELD_EFFIDDY_LEFT
    def_bool $(shields_list_contains,effiddy_left)

config SHIELD_EFFIDDY_RIGHT
    def_bool $(shields_list_contains,effiddy_right)
```
